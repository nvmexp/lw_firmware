OUTPUT_ARCH( "riscv" )
ENTRY(fmc_entry)

MEMORY {
    // this will be also identity mapped
    imem_pa (rwx) : ORIGIN = 0x100000, LENGTH = 0x400
}

SECTIONS
{
  .fmc :
  {
      KEEP(*(.text.fmc_entry))
      *(.text* .rodata* .srodata*)
      . = ALIGN(16);
      *(.data* .sdata* .bss* .sbss*)
      . = ALIGN(256);
  } > imem_pa
  __fmc_size = SIZEOF(.fmc);
  __fmc_carveout_size = LENGTH(imem_pa);
}
